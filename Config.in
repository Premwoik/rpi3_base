## Config.in
```kconfig
# Add project-specific packages for Buildroot here
#
# If these are non-proprietary, please consider contributing them back to
# Nerves or Buildroot.
#
#
menu "Custom Packages"

source "$NERVES_DEFCONFIG_DIR/packages/python-erlport/Config.in"
source "$NERVES_DEFCONFIG_DIR/packages/python-pymax/Config.in"

endmenu
```

## packages/python-erlport/Config.in
```kconfig
config BR2_PACKAGE_PYTHON_ERLPORT
	bool "python-erlport"
	help
	  Erlang port protocol.

	  http://github.com/hdima/erlport
```

## packages/python-pymax/Config.in
```kconfig
config BR2_PACKAGE_PYTHON_PYMAX
	bool "python-pymax"
	help
	  Python implementation of the ELV MAX! Cube API.

	  https://ercpe.de/projects/pymax
```
